## config/west.yml
```yaml
manifest:
  remotes:
    - name: zmkfirmware
      url-base: https://github.com/zmkfirmware
    - name: urob
      url-base: https://github.com/urob
    # Skeletyl
    - name: cyanindya
      url-base: https://github.com/cyanindya
  projects:
    - name: zmk
      remote: zmkfirmware
      revision: v0.3.0
      import: app/west.yml
    - name: zmk-helpers
      remote: urob
      revision: v0.3.0
    # Skeletyl
    - name: zmk-keyboard-skeletyl-handwired
      remote: cyanindya
      revision: main
      # import: west.yml
    # Eyelash Corne
    - name: eyelash_corne
      url: https://github.com/a741725193/zmk-new_corne
      revision: main
    - name: nice-view-mod
      remote: cyanindya
      revision: main
  self:
    path: config
```
